## Kconfig
```kconfig
config ZMK_FEATURE_SPLITBATTERY_REPORT
    bool "Battery report behavior (split, on-demand)"
    default y
```

## dts/bindings/behaviors/zmk,behavior-battery-report.yaml
```yaml
# Copyright (c) 2025 The ZMK Contributors
# SPDX-License-Identifier: MIT

description: Battery report behavior

compatible: "zmk,behavior-battery-report"

include: zero_param.yaml
```

## tests/west.yml
```yaml
manifest:
  remotes:
    - name: zmkfirmware
      url-base: https://github.com/zmkfirmware
  projects:
    - name: zmk
      remote: zmkfirmware
      revision: v0.3 # Maintained by the upgrade-zmk workflow
      import: app/west.yml
  self:
    path: tests
```
